## meta/conf/machine/nativesys-x86-64.conf
```bitbake
PREFERRED_PROVIDER_virtual/xserver ?= "xserver-xorg"
PREFERRED_PROVIDER_virtual/egl ?= "mesa"
PREFERRED_PROVIDER_virtual/libgl ?= "mesa"
PREFERRED_PROVIDER_virtual/libgles1 ?= "mesa"
PREFERRED_PROVIDER_virtual/libgles2 ?= "mesa"

require conf/machine/include/tune-x86_64.inc

TCMODE = "nativesys"

KERNEL_IMAGETYPE = "bzImage"

SERIAL_CONSOLE = "115200 ttyS0"

MACHINE_FEATURES += "x86"

XSERVER ?= "xserver-xorg \
            ${@base_contains('DISTRO_FEATURES', 'opengl', 'mesa-driver-swrast', '', d)} \
            xf86-input-evdev \
            xf86-input-mouse \
            xf86-video-fbdev \
            xf86-input-keyboard"

MACHINE_FEATURES = "alsa bluetooth usbgadget screen"

IMAGE_FSTYPES += "tar.bz2 ext3"

# Don't include kernels in standard images
RDEPENDS_kernel-base = ""

# Use a common kernel recipe for all QEMU machines
PREFERRED_PROVIDER_virtual/kernel ?= "linux-yocto"
```

## meta/conf/machine/qemunios2.conf
```bitbake
#@TYPE: Machine
#@NAME: qemunios2
#@DESCRIPTION: Machine for qemunios2

require conf/machine/include/qemu.inc
require conf/machine/include/tune-nios2.inc

PREFERRED_VERSION_linux-yocto ??= "4.9%"
KERNEL_IMAGETYPE = "vmlinux"
KERNEL_DEVICETREE = "10m50_devboard.dtb"

INITRAMFS_IMAGE ?= "core-image-minimal"
INITRAMFS_IMAGE_BUNDLE = "1"
IMAGE_FSTYPES = "cpio.gz"
USE_DEVFS = "0"

SERIAL_CONSOLES ?= "115200;ttyS0"

# For runqemu
QB_SYSTEM_NAME = "qemu-system-nios2"
QB_MACHINE = "-machine altera_10m50_mmu"

QB_KERNEL_CMDLINE_APPEND = "console=ttyS0,115200 debug earlyconsole  mem=256M"
QB_CPU = "-cpu nios2"
QB_NET = "none"
QB_DTB = "vmlinux-10m50_devboard.dtb"

#QB_OPT_APPEND = "-nographic -net nic,model=ALTR.tse,macaddr=00:aa:bb:cc:dd:ee -net tap,ifname=tap0,script=no,downscript=no"
QB_OPT_APPEND = "-nographic -net nic,model=ALTR.tse,macaddr=00:aa:bb:cc:dd:ee -net dump,file=/tmp/altr.pcap -net user"
QB_DEFAULT_FSTYPE = "cpio.gz"
QB_DEFAULT_KERNEL = "vmlinux-initramfs-qemunios2.bin"
```

## meta/conf/machine/qemuppc64.conf
```bitbake
#@TYPE: Machine
#@NAME: qemu PPC 64 Emulator setup
#@DESCRIPTION: Machine configuration for running an PPC system under qemu emulation

require conf/machine/include/qemu.inc
DEFAULTTUNE ?= "ppc64p6"
require conf/machine/include/tune-power6.inc

KERNEL_IMAGETYPE = "vmlinux"

SERIAL_CONSOLES = "115200;ttyS0 115200;ttyS1"

MACHINE_EXTRA_RRECOMMENDS = " kernel-modules"
```

## scripts/lib/wic/canned-wks/beaglebone.wks
```
# short-description: Create Beaglebone disk image
# long-description: Creates a partitioned disk image for Beaglebone board
# which can be directly copied to SD card.

part /boot --ondisk mmcblk0 --label boot --fstype vfat --source bootimg-partition --align 1024 --active
part /     --ondisk mmcblk0 --label root --fstype ext4 --source rootfs --align 1024
```

## scripts/lib/wic/canned-wks/generic-efi.wks
```
# short-description: Create an EFI disk image
# long-description: Creates a partitioned EFI disk image that the user
# can directly dd to boot media.

part /boot --source rootfs --rootfs-dir=/home/swold/yocto/releases/master/build/intel-dev/tmp/deploy/images/intel-corei7-64/bootfs --fstype=vfat --label boot --active --align 1024

part / --source rootfs --fstype=ext4 --label root --align 1024 --uuid ${ROOTFS_PARTUUID}

bootloader --ptable gpt
```
