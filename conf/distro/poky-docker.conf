## conf/distro/poky-docker.conf
```bitbake
require conf/distro/poky.conf
DISTRO = "poky-docker"
DISTRO_NAME = "poky-systemd-docker"

# Docker happier with systemd
DISTRO_FEATURES_append = " systemd"
VIRTUAL-RUNTIME_init_manager = "systemd"
DISTRO_FEATURES_BACKFILL_CONSIDERED = "sysvinit"
VIRTUAL-RUNTIME_initscripts = "systemd-compat-units"
```

## conf/layer.conf
```bitbake
# We have a conf and classes directory, add to BBPATH
BBPATH .= ":${LAYERDIR}"

# We have recipes-* directories, add to BBFILES
BBFILES += "${LAYERDIR}/recipes-*/*/*.bb \
            ${LAYERDIR}/recipes-*/*/*.bbappend"

BBFILE_COLLECTIONS += "meta-lxc-dpdk"
BBFILE_PATTERN_meta-lxc-dpdk = "^${LAYERDIR}/"
BBFILE_PRIORITY_meta-lxc-dpdk = "6"

LAYERDEPENDS_meta-lxc-dpdk = "core"
LAYERSERIES_COMPAT_meta-lxc-dpdk = "mickledore nanbield"
```

## meta-arc/conf/layer.conf
```bitbake
# We have a conf and classes directory, add to BBPATH
BBPATH := "${BBPATH}:${LAYERDIR}"

# We have a packages directory, add to BBFILES
BBFILES += "${LAYERDIR}/recipes*/*/*.bb ${LAYERDIR}/recipes*/*/*.bbappend"

BBFILE_COLLECTIONS += "meta-arc"
BBFILE_PATTERN_meta-arc := "^${LAYERDIR}/"
BBFILE_PRIORITY_meta-arc = "8"
```

## meta-arc/conf/machine/arch-arc.inc
```bitbake
DEFAULTTUNE ?= "arc"

TUNE_ARCH = "arc"
TUNE_PKGARCH = "arc"
TUNE_FEATURES_tune-arc = "bigendian"
TUNE_CCARGS = "-mARCv2EM -mav2em"

TUNEVALID[bigendian] = "Big endian mode"
```

## meta-baremetal/conf/distro/include/tclibc-baremetal.inc
```bitbake
#
# baremetal configuration
#

LIBCEXTENSION = ""

# Add baremetal libc overrides to the overrides.
LIBCOVERRIDE = ":libc-baremetal"
OVERRIDES .= "${LIBCOVERRIDE}"

ASSUME_PROVIDED += "virtual/libc virtual/libiconv"

PREFERRED_PROVIDER_virtual/libc ?= "musl"
PREFERRED_PROVIDER_virtual/libiconv ?= "musl"
PREFERRED_PROVIDER_virtual/libintl ?= "gettext"
PREFERRED_PROVIDER_virtual/nativesdk-libintl ?= "nativesdk-eglibc"
PREFERRED_PROVIDER_virtual/nativesdk-libiconv ?= "nativesdk-eglibc"

USE_NLS ?= "no"
IMAGE_LINGUAS = ""
LIBC_DEPENDENCIES = ""

# Doesn't work due to overrides issues
#DEPENDS_remove_pn-gcc-cross-${TARGET_ARCH} = "virtual/${TARGET_PREFIX}libc-for-gcc"
#EXTRA_OECONF_pn-gcc-cross-${TARGET_ARCH}_append = " --without-headers"

DEPENDS_remove_pn-meta-toolchain = "virtual/libc virtual/${TARGET_PREFIX}compilerlibs"

TARGET_OS = "elf"
TARGET_OS_arm = "eabi"

TOOLCHAIN_HOST_TASK ?= "nativesdk-packagegroup-sdk-host packagegroup-cross-canadian-${MACHINE}"
#TOOLCHAIN_HOST_TASK ?= "packagegroup-cross-canadian-${MACHINE}"
TOOLCHAIN_HOST_TASK_ATTEMPTONLY ?= ""
TOOLCHAIN_TARGET_TASK ?= "libgcc-dev"
TOOLCHAIN_NEED_CONFIGSITE_CACHE_remove = "${TCLIBC} zlib ncurses"
```

## meta-baremetal/conf/layer.conf
```bitbake
# We have a conf and classes directory, add to BBPATH
BBPATH := "${BBPATH}:${LAYERDIR}"

# We have a packages directory, add to BBFILES
BBFILES += "${LAYERDIR}/recipes*/*/*.bb ${LAYERDIR}/recipes*/*/*.bbappend"

BBFILE_COLLECTIONS += "meta-baremetal"
BBFILE_PATTERN_meta-baremetal := "^${LAYERDIR}/"
BBFILE_PRIORITY_meta-baremetal = "8"
```

## meta-patchtest/conf/layer.conf
```bitbake
# We have a conf and classes directory, add to BBPATH
BBPATH .= ":${LAYERDIR}"

# We have recipes-* directories, add to BBFILES
BBFILES += "${LAYERDIR}/recipes-*/*/*.bb \
	${LAYERDIR}/recipes-*/*/*.bbappend"

BBFILE_COLLECTIONS += "patchtest"
BBFILE_PATTERN_patchtest = "^${LAYERDIR}/"
BBFILE_PRIORITY_patchtest = "6"
```

## meta-poky/conf/distro/include/reproducible_build.inc
```bitbake
BUILD_REPRODUCIBLE_BINARIES = "1"

REPRODUCIBLE_TIMESTAMP_ROOTFS ?= "1483228802"

LDCONFIGDEPEND = ""

do_image_cpio[depends] += "cpio-replacement-native:do_populate_sysroot"
EXTRANATIVEPATH += "cpio-native"
IMAGE_CMD_CPIO = "cpio --ignore-devno --reproducible "

IMAGE_CMD_TAR = "tar -v --sort=name "

INHERIT += "reproducible_build"
```

## meta-poky/conf/distro/poky-reproducible.conf
```bitbake
require conf/distro/poky.conf
require conf/distro/include/reproducible_build.inc

DISTRO = "poky-reproducible"

# For reproducibility, we need to consistently assign the UID/GID values.
# Use the static uid and gid mechanism from OE-core for that:
# http://www.yoctoproject.org/docs/latest/mega-manual/mega-manual.html#ref-classes-useradd
#
# Dynamically assigned IDs are detected and lead to an error during
# the build.
#
# Developers who need to add new entries should add their own mapping
# file to USERADD_UID_TABLES and/or USERADD_GID_TABLES, either in a
# derived distro config or in their local.conf.
#
# It is also possible to disable the mechanism by modifying USERADD_ERROR_DYNAMIC:
# "warn" merely prints a warning, empty value silently allows dynamic
# ID allocation.
#
# The actual files for UID/GID values come from core-image-minimal-sdk
# /etc/group
# /etc/passwd

#USERADDEXTENSION = "useradd-staticids"
#USERADD_ERROR_DYNAMIC ??= "warn"
#USERADD_UID_TABLES += "conf/distro/include/reproducible-passwd"
#USERADD_GID_TABLES += "conf/distro/include/reproducible-group"

PACKAGE_CLASSES = "package_deb"
```

## meta-runtime-perf/conf/layer.conf
```bitbake
# We have a conf and classes directory, add to BBPATH
BBPATH .= ":${LAYERDIR}"

# We have recipes-* directories, add to BBFILES
BBFILES += "${LAYERDIR}/recipes-*/*/*.bb \
	${LAYERDIR}/recipes-*/*/*.bbappend"

BBFILE_COLLECTIONS += "runtime-perf"
BBFILE_PATTERN_runtime-perf = "^${LAYERDIR}/"
BBFILE_PRIORITY_runtime-perf = "5"

LAYERDEPENDS_runtime-perf = "openembedded-layer"
```

## meta-yocto-bsp/conf/machine/beaglebone-yocto.conf
```bitbake
#@TYPE: Machine
#@NAME: Beaglebone-yocto machine
#@DESCRIPTION: Reference machine configuration for http://beagleboard.org/bone and http://beagleboard.org/black boards

PREFERRED_PROVIDER_virtual/xserver ?= "xserver-xorg"

MACHINE_EXTRA_RRECOMMENDS = "kernel-modules"

EXTRA_IMAGEDEPENDS += "virtual/bootloader"

DEFAULTTUNE ?= "cortexa8hf-neon"
include conf/machine/include/arm/armv7a/tune-cortexa8.inc

IMAGE_FSTYPES += "tar.bz2 jffs2 wic wic.bmap"
EXTRA_IMAGECMD:jffs2 = "-lnp "
WKS_FILE ?= "beaglebone-yocto.wks"

# Setting this variable to "1" switches from zImage kernel to FIT image kernel
FIT_IMAGE_KERNEL ?= "0"

# Note: This is redundant if wic creates a separate /boot partition
MACHINE_ESSENTIAL_EXTRA_RDEPENDS += "${@'linux-yocto-fitimage' if d.getVar('FIT_IMAGE_KERNEL') == '1' else 'kernel-image kernel-devicetree'}"

KERNEL_CLASSES += "${@'kernel-fit-extra-artifacts' if d.getVar('FIT_IMAGE_KERNEL') == '1' else ''}"
do_image_wic[depends] += "\
    mtools-native:do_populate_sysroot \
    dosfstools-native:do_populate_sysroot \
    virtual/bootloader:do_deploy \
    ${@'linux-yocto-fitimage:do_deploy' if d.getVar('FIT_IMAGE_KERNEL') == '1' else ''} \
"

SERIAL_CONSOLES ?= "115200;ttyS0 115200;ttyO0 115200;ttyAMA0"

PREFERRED_PROVIDER_virtual/kernel ?= "linux-yocto"
PREFERRED_VERSION_linux-yocto ?= "6.12%"

KERNEL_IMAGETYPE = "zImage"
DTB_FILES = "am335x-bone.dtb am335x-boneblack.dtb am335x-bonegreen.dtb"
KERNEL_DEVICETREE = '${@' '.join('ti/omap/%s' % d for d in '${DTB_FILES}'.split())}'
FIT_CONF_DEFAULT_DTB = "am335x-boneblack.dtb"

# Configure the image.bbclass to depend on the fitImage instead of only
# the kernel to ensure the fitImage is built with the image
KERNEL_DEPLOY_DEPEND = "${@'linux-yocto-fitimage:do_deploy' if d.getVar('FIT_IMAGE_KERNEL') == '1' else 'virtual/kernel:do_deploy'}"

PREFERRED_PROVIDER_virtual/bootloader ?= "u-boot"

SPL_BINARY = "MLO"
UBOOT_SUFFIX = "img"
UBOOT_MACHINE = "am335x_evm_defconfig"
UBOOT_ENTRYPOINT = "0x80008000"
UBOOT_LOADADDRESS = "0x80008000"
UBOOT_DTB_LOADADDRESS = "0x88000000"
UBOOT_DTBO_LOADADDRESS = "0x88080000"
UBOOT_RD_LOADADDRESS = "0x89000000"
UBOOT_RD_ENTRYPOINT = "0x89000000"

MACHINE_FEATURES = "usbgadget usbhost vfat alsa"

# Configure wic to create a /boot partition with either zImage or fitImage
IMAGE_BOOT_FILES ?= "u-boot.${UBOOT_SUFFIX} ${SPL_BINARY} \
    ${@'fitImage' if d.getVar('FIT_IMAGE_KERNEL') == '1' else '${KERNEL_IMAGETYPE} ${DTB_FILES}'} \
"

# support runqemu
EXTRA_IMAGEDEPENDS += "qemu-native qemu-helper-native"
IMAGE_CLASSES += "qemuboot"
QB_DEFAULT_FSTYPE = "wic"
QB_FSINFO = "wic:no-kernel-in-fs"
QB_KERNEL_ROOT = "/dev/vda2"
QB_SYSTEM_NAME = "qemu-system-arm"
QB_MACHINE = "-machine virt"
QB_CPU = "-cpu cortex-a15"
QB_KERNEL_CMDLINE_APPEND = "console=ttyAMA0 systemd.mask=systemd-networkd"
QB_OPT_APPEND = "\
    -device virtio-rng-device \
    ${@' -initrd %s/%s.%s' % (d.getVar('DEPLOY_DIR_IMAGE'), d.getVar('INITRAMFS_IMAGE_NAME'), d.getVar('INITRAMFS_FSTYPES')) if d.getVar('INITRAMFS_IMAGE') else ''} \
"
QB_TAP_OPT = "-netdev tap,id=net0,ifname=@TAP@,script=no,downscript=no"
QB_NETWORK_DEVICE = "-device virtio-net-device,netdev=net0,mac=@MAC@"
QB_ROOTFS_OPT = "-drive id=disk0,file=@ROOTFS@,if=none,format=raw -device virtio-blk-device,drive=disk0"
QB_SERIAL_OPT = ""
QB_TCPSERIAL_OPT = "-device virtio-serial-device -chardev socket,id=virtcon,port=@PORT@,host=127.0.0.1 -device virtconsole,chardev=virtcon"
```

## meta-yocto-bsp/conf/machine/containerx86-64.conf
```bitbake
#@TYPE: Machine
#@NAME: Generic X86_64.

#@DESCRIPTION: Machine configuration for generic X86_64 (64-bit) containers.

PREFERRED_PROVIDER_virtual/kernel = "linux-dummy"

require conf/machine/genericx86-64.conf
```

## meta-yocto-bsp/conf/machine/generic-arm64.conf
```bitbake
#@TYPE: Machine
#@NAME: generic-arm64
#@DESCRIPTION: Generic Arm64 machine for typical SystemReady platforms, which
#have working firmware and boot via EFI.

require conf/machine/include/arm/arch-armv8a.inc

# Arm Base System Architecture says  v8.0+ is allowed, but the FEAT_CRC32
# instructions are mandatory.
DEFAULTTUNE = "armv8a-crc"

MACHINE_EXTRA_RRECOMMENDS += "kernel-modules linux-firmware"
MACHINE_FEATURES = "acpi alsa bluetooth efi keyboard pci qemu-usermode rtc screen usbhost vfat wifi"

PREFERRED_PROVIDER_virtual/kernel ?= "linux-yocto"
KERNEL_IMAGETYPE = "Image.zstd"

IMAGE_FSTYPES ?= "wic"
WKS_FILE ?= "mkefidisk.wks.in"
EFI_PROVIDER ?= "${@bb.utils.contains("DISTRO_FEATURES", "systemd", "systemd-boot", "grub-efi", d)}"

SERIAL_CONSOLES ?= "115200;ttyAMA0 115200;hvc0"

# For boot on some boards we need drivers built as modules.
# Let's put them into minimal initramfs and append it to the kernel image.
PACKAGE_INSTALL:append:pn-core-image-minimal-initramfs = " kernel-modules"
INITRAMFS_MAXSIZE:pn-core-image-minimal-initramfs ?= "262144"
INITRAMFS_IMAGE ?= "core-image-minimal-initramfs"
INITRAMFS_IMAGE_BUNDLE ?= "1"
```

## meta/conf/distro/include/poky-ppc.inc
```bitbake
#
# Poky configuration for PowerPC
# gcc 4.2.3, binutils 2.18, glibc 2.5
# use gcc 4.3.1 for armv7 targets
#

TARGET_VENDOR = "-poky"

PREFERRED_PROVIDER_virtual/${TARGET_PREFIX}libc-for-gcc = "glibc"
PREFERRED_PROVIDER_virtual/${TARGET_PREFIX}binutils = "binutils-cross"
PREFERRED_PROVIDER_virtual/${TARGET_PREFIX}gcc-initial = "gcc-cross-initial"
PREFERRED_PROVIDER_virtual/${TARGET_PREFIX}gcc-intermediate = "gcc-cross-intermediate"
PREFERRED_PROVIDER_virtual/${TARGET_PREFIX}gcc = "gcc-cross"
PREFERRED_PROVIDER_virtual/${TARGET_PREFIX}g++ = "gcc-cross"

GCCVERSION ?= "4.2.3"
BINUVERSION = "2.19"
GLIBCVERSION ?= "2.6.1"
LINUXLIBCVERSION ?= "2.6.20"

PREFERRED_VERSION_gcc ?= "${GCCVERSION}"
PREFERRED_VERSION_gcc-cross ?= "${GCCVERSION}"
PREFERRED_VERSION_gcc-cross-initial ?= "${GCCVERSION}"
PREFERRED_VERSION_gcc-cross-intermediate ?= "${GCCVERSION}"
PREFERRED_VERSION_gcc-crosssdk ?= "${GCCVERSION}"
PREFERRED_VERSION_gcc-crosssdk-initial ?= "${GCCVERSION}"
PREFERRED_VERSION_gcc-crosssdk-intermediate ?= "${GCCVERSION}"
PREFERRED_VERSION_gcc-cross-canadian ?= "${GCCVERSION}"
PREFERRED_VERSION_binutils ?= "${BINUVERSION}"
PREFERRED_VERSION_binutils-cross ?= "${BINUVERSION}"
PREFERRED_VERSION_binutils-crosssdk ?= "${BINUVERSION}"
PREFERRED_VERSION_binutils-cross-canadian ?= "${BINUVERSION}"
PREFERRED_VERSION_linux-libc-headers ?= "${LINUXLIBCVERSION}"
PREFERRED_VERSION_linux-libc-headers-nativesdk ?= "${LINUXLIBCVERSION}"
PREFERRED_VERSION_glibc ?= "${GLIBCVERSION}"
PREFERRED_VERSION_glibc-initial ?= "${GLIBCVERSION}"
PREFERRED_VERSION_glibc-nativesdk ?= "${GLIBCVERSION}"
PREFERRED_VERSION_glibc-initial-nativesdk ?= "${GLIBCVERSION}"
PREFERRED_VERSION_elfutils ?= "0.131"
PREFERRED_VERSION_u-boot-mkimage-native ?= "2009.08"

require conf/distro/include/as-needed.inc
```

## meta/conf/distro/include/ptest-packagelists.inc
```bitbake
#
# Lists of the ptests in OE-Core, sorted into two sets by the time they take
#
# ptests which take less than ~30s each
#
PTESTS_FAST = "\
    python3-cryptography \
"
PTESTS_FAST:append:libc-glibc = " glibc-y2038-tests"
PTESTS_PROBLEMS:remove:libc-glibc = "glibc-y2038-tests"
PTESTS_FAST:remove:mips64 = "qemu"
PTESTS_PROBLEMS:append:mips64 = " qemu"
PTESTS_FAST:remove:riscv32 = "qemu"
PTESTS_PROBLEMS:append:riscv32 = " qemu"

PTESTS_SLOW = "\
"

# python3 ptests hang on qemuriscv64
PTESTS_SLOW:remove:riscv64 = "valgrind python3"
PTESTS_PROBLEMS:append:riscv64 = " valgrind python3"
PTESTS_SLOW:remove:riscv32 = "lttng-tools strace valgrind"
PTESTS_PROBLEMS:append:riscv32 = " lttng-tools strace valgrind"
PTESTS_SLOW:append:libc-musl = " libc-test"
PTESTS_SLOW:remove:x86 = "valgrind"
PTESTS_PROBLEMS:append:x86 = " valgrind"

#    ruby \ # Timeout
#    rt-tests \ # Needs to be checked whether it runs at all
#    bash \ # Test outcomes are non-deterministic by design
#    ifupdown \ # Tested separately in lib/oeqa/selftest/cases/imagefeatures.py
#    libinput \ # Tests need an unloaded system to be reliable
#    libpam \ # Needs pam DISTRO_FEATURE
#    mdadm \ # tests are flaky in AB.
#    numactl \ # qemu not (yet) configured for numa; all tests are skipped
#    libseccomp \ #  tests failed: 38; add to slow tests once addressed
#    python3-numpy \ # requires even more RAM and (possibly) disk space; multiple failures

PTESTS_PROBLEMS = "\
    ruby \
    rt-tests \
    bash \
    ifupdown \
    libinput \
    libpam \
    libseccomp \
    mdadm \
    numactl \
    python3-license-expression \
    python3-numpy \
"
```

## meta/conf/distro/include/yocto-uninative.inc
```bitbake
#
# This include points at uninative tarballs generated and maintained
# by the Yocto Project. These file can be included by distros if they
# want to use/maintain a unified sstate feed for native/cross artefacts
# rather than the feeds having native/cross artefacts which are specific
# to the distro running on the build machine.
#

UNINATIVE_URL = "http://downloads.yoctoproject.org/releases/uninative/1.0/"
UNINATIVE_CHECKSUM[i686] ?= "94a4693ec2df05d326e13dc1b613b7810ec7eeb5c9ce61d107c672cba49ac51a"
UNINATIVE_CHECKSUM[x86_64] ?= "d3f2153800a730f647d0e06b76be5321ca400a076ffcf90d5512b72098406a61"
```

## meta/conf/machine/include/arm/arch-arm.inc
```bitbake
TUNEVALID[bigendian] = "Enable big-endian mode."

ARMPKGARCH = "${ARMPKGARCH_tune-${DEFAULTTUNE}}"
ARMPKGSFX_ENDIAN = "${@bb.utils.contains('TUNE_FEATURES', 'bigendian', 'b', '', d)}"
ARMPKGSFX_FPU ??= ""
ARMPKGSFX_DSP ??= ""
ARMPKGSFX_EABI ??= ""
ARMPKGSFX_THUMB ??= ""

TUNE_ARCH = "${@bb.utils.contains('TUNE_FEATURES', 'bigendian', 'armeb', 'arm', d)}"
TUNE_PKGARCH = "${ARMPKGARCH}${ARMPKGSFX_THUMB}${ARMPKGSFX_DSP}${ARMPKGSFX_EABI}${ARMPKGSFX_ENDIAN}${ARMPKGSFX_FPU}"

# Prefer -mcpu= over -arch=
TUNE_CCARGS_MCPU ??= ""
TUNE_CCARGS_MARCH ??= ""
TUNE_CCARGS_FEATURES ??= ""
TUNE_CCARGS .= "${@d.getVar('TUNE_CCARGS_MCPU') or d.getVar('TUNE_CCARGS_MARCH')}${TUNE_CCARGS_FEATURES}"

ABIEXTENSION = "eabi"

TARGET_FPU = "${@d.getVar('TUNE_CCARGS_MFLOAT') or 'soft'}"
```
